## Documentation/devicetree/bindings/power/arm,mali-opp.yaml
```yaml
# SPDX-License-Identifier: GPL-2.0 WITH Linux-syscall-note
#
# (C) COPYRIGHT 2025 ARM Limited. All rights reserved.
#
# This program is free software and is provided to you under the terms of the
# GNU General Public License version 2 as published by the Free Software
# Foundation, and any use by you of this program is subject to the terms
# of such GNU license.
#
# This program is distributed in the hope that it will be useful,
# but WITHOUT ANY WARRANTY; without even the implied warranty of
# MERCHANTABILITY or FITNESS FOR A PARTICULAR PURPOSE. See the
# GNU General Public License for more details.
#
# You should have received a copy of the GNU General Public License
# along with this program; if not, you can access it online at
# http://www.gnu.org/licenses/gpl-2.0.html.
#
#
%YAML 1.2
---
$id: http://devicetree.org/schemas/power/arm,mali-opp.yaml#
$schema: http://devicetree.org/meta-schemas/core.yaml#

title: ARM Mali Midgard OPP Table

description: |
  This schema defines the Operating Performance Points (OPPs) for ARM Mali Midgard GPUs.
  OPPs describe performance states combining frequency, voltage, and shader core configurations
  that the driver can use for dynamic power management and performance scaling. The table supports
  dynamic frequency and voltage scaling (DVFS) along with features such as turbo mode, suspend
  operation, hardware version selection, and shader core masking.

maintainers:
  - ARM Ltd.

select:
  properties:
    compatible:
      contains:
        enum:
          - operating-points-v2-mali
  required:
    - compatible

properties:
  compatible:
    items:
      - const: operating-points-v2
      # Declares the node as an OPP table.
      - const: operating-points-v2-mali
      # Indicates the presence of Mali-specific extensions.

patternProperties:
  "^opp(-[0-9a-f]+)?$":
    type: object
    description: |
      Describes a single Operating Performance Point (OPP) entry.
    properties:
      opp-hz:
        description: |
          Nominal frequency in Hz, as a 64-bit big-endian integer. This value serves as a relative
          performance indicator, taking into account both the GPU clock and shader core configuration.

      opp-hz-real:
        description: |
          One or two real frequency values in Hz (64-bit big-endian integers), corresponding to the
          GPU clock frequencies defined under the Mali device node.
        $ref: /schemas/types.yaml#/definitions/uint64-array

      opp-core-mask:
        description: |
          Shader core mask expressed as a 64-bit big-endian integer. If neither opp-core-mask nor
          opp-core-count is specified, all shader cores are assumed to be active.
        $ref: /schemas/types.yaml#/definitions/uint64

      opp-core-count:
        description: |
          The number of shader cores to use for this OPP (must be > 0). If provided, the driver
          constructs a core mask based on hardware configuration. If both opp-core-count and
          opp-core-mask are provided, opp-core-mask is ignored.
        $ref: /schemas/types.yaml#/definitions/uint32

      opp-microvolt:
        description: |
          List of one or two voltages in micro Volts. They shall correspond
          to the regulators declared under the Mali device node, and follow the order:
          "toplevel", "shadercores".

          A single regulator's voltage is specified with an array of size one or three.
          Single entry is for target voltage and three entries are for <target min max>
          voltages.

          Entries for multiple regulators must be present in the same order as
          regulators are specified in device's DT node.

      opp-microamp:
        description: |
          The maximum current drawn by the device in microamperes
          considering system specific parameters (such as transients, process, aging,
          maximum operating temperature range etc.) as necessary. This may be used to
          set the most efficient regulator operating mode.

          Should only be set if opp-microvolt is set for the OPP.

          Entries for multiple regulators must be present in the same order as
          regulators are specified in device's DT node. If this property isn't required
          for few regulators, then this should be marked as zero for them. If it isn't
          required for any regulator, then this property need not be present.

      clock-latency-ns:
        description: |
          Maximum clock transition latency in nanoseconds for switching from another OPP to this one.

      turbo-mode:
        description: |
          A boolean flag indicating that this OPP is available only for turbo mode operation.
          Turbo mode permits the GPU to run above its nominal frequency for brief durations, subject
          to thermal and power constraints.
        type: boolean

      opp-suspend:
        description: |
          A boolean flag that marks this OPP for use during device suspend.
          Only one OPP in the table should have this flag set.
        type: boolean

      opp-mali-errata-1485982:
        description: |
          Marks the OPP to be selected for suspend clock.
          This will be effective only if MALI_HW_ERRATA_1485982_USE_CLOCK_ALTERNATIVE is
          enabled. It needs to be placed in any OPP that has proper suspend clock for
          the HW workaround.
        type: boolean

      opp-supported-hw:
        description: |
          This enables us to select only a subset of OPPs from the
          larger OPP table, based on what version of the hardware we are running on. We
          still can't have multiple nodes with the same opp-hz value in OPP table.

          It's a user defined array containing a hierarchy of hardware version numbers,
          supported by the OPP. For example: a platform with hierarchy of three levels
          of versions (A, B and C), this field should be like <X Y Z>, where X
          corresponds to Version hierarchy A, Y corresponds to version hierarchy B and Z
          corresponds to version hierarchy C.

          Each level of hierarchy is represented by a 32 bit value, and so there can be
          only 32 different supported version per hierarchy. i.e. 1 bit per version. A
          value of 0xFFFFFFFF will enable the OPP for all versions for that hierarchy
          level. And a value of 0x00000000 will disable the OPP completely, and so we
          never want that to happen.

          If 32 values aren't sufficient for a version hierarchy, than that version
          hierarchy can be contained in multiple 32 bit values. i.e. <X Y Z1 Z2> in the
          above example, Z1 & Z2 refer to the version hierarchy Z.
        $ref: /schemas/types.yaml#/definitions/uint32-matrix

      status:
        description: |
          Indicates whether this OPP is enabled/disabled.
        $ref: /schemas/types.yaml#/definitions/status

    patternProperties:
      "^opp-microvolt-.*$":
        description: |
          Named opp-microvolt property. This is exactly similar to
          the above opp-microvolt property, but allows multiple voltage ranges to be
          provided for the same OPP. At runtime, the platform can pick a <name> and
          matching opp-microvolt-<name> property will be enabled for all OPPs. If the
          platform doesn't pick a specific <name> or the <name> doesn't match with any
          opp-microvolt-<name> properties, then opp-microvolt property shall be used, if
          present.
        $ref: /schemas/types.yaml#/definitions/uint32-array

      "^opp-microamp-.*$":
        description: |
          Named opp-microamp property. Similar to "opp-microvolt-.*$" but for microamp instead.
        $ref: /schemas/types.yaml#/definitions/uint32-array

    required:
      - opp-hz
    additionalProperties: false

required:
  - compatible

additionalProperties: true

examples:
  # Example for a Juno with 1 clock and 1 regulator
  - |
    gpu_opp_table_example1: opp-table-0 {
        compatible = "operating-points-v2", "operating-points-v2-mali";

        opp-112500000 {
            opp-hz = /bits/ 64 <112500000>;
            opp-hz-real = /bits/ 64 <450000000>;
            opp-microvolt = <820000>;
            opp-core-mask = /bits/ 64 <0x1>;
            opp-suspend;
            opp-mali-errata-1485982;
        };
        opp-225000000 {
            opp-hz = /bits/ 64 <225000000>;
            opp-hz-real = /bits/ 64 <450000000>;
            opp-microvolt = <820000>;
            opp-core-count = <2>;
        };
        opp-450000000 {
            opp-hz = /bits/ 64 <450000000>;
            opp-hz-real = /bits/ 64 <450000000>;
            opp-microvolt = <820000>;
            opp-core-mask = /bits/ 64 <0xf>;
        };
        opp-487500000 {
            opp-hz = /bits/ 64 <487500000>;
            opp-microvolt = <825000>;
        };
        opp-525000000 {
            opp-hz = /bits/ 64 <525000000>;
            opp-microvolt = <850000>;
        };
        opp-562500000 {
            opp-hz = /bits/ 64 <562500000>;
            opp-microvolt = <875000>;
        };
        opp-600000000 {
            opp-hz = /bits/ 64 <600000000>;
            opp-microvolt = <900000>;
        };
    };

  # Example for a Juno with 2 clocks and 2 regulators
  - |
    gpu_opp_table_example2: opp-table-0 {
        compatible = "operating-points-v2", "operating-points-v2-mali";

        opp-0 {
            opp-hz = /bits/ 64 <50000000>;
            opp-hz-real = /bits/ 64 <50000000>, /bits/ 64 <45000000>;
            opp-microvolt = <820000>, <800000>;
            opp-core-mask = /bits/ 64 <0xf>;
        };
        opp-1 {
            opp-hz = /bits/ 64 <40000000>;
            opp-hz-real = /bits/ 64 <40000000>, /bits/ 64 <35000000>;
            opp-microvolt = <720000>, <700000>;
            opp-core-mask = /bits/ 64 <0x7>;
        };
        opp-2 {
            opp-hz = /bits/ 64 <30000000>;
            opp-hz-real = /bits/ 64 <30000000>, /bits/ 64 <25000000>;
            opp-microvolt = <620000>, <700000>;
            opp-core-mask = /bits/ 64 <0x3>;
        };
    };
```

## drivers/input/touchscreen/mediatek/NT36xxx_SPI/Kconfig
```kconfig
#
# Novatek NT36xxx SPI touchscreen driver configuration
#
config TOUCHSCREEN_NT36xxx_SPI
	bool "Novatek NT36xxx SPI driver"
	default n
	help
	  Say Y here if you have a Novatek NT36xxx to your system by SPI bus.

	  If unsure, say N.

config TOUCHSCREEN_NT36xxx_SPI_MP_CTRLRAM
	bool "Novatek NT36xxx SPI Multipoint Control RAM"
	depends on TOUCHSCREEN_NT36xxx_SPI
	default n
	help
	  Say Y here if you need to use Multipoint Control RAM Testing

	  If unsure, say N.
```

## drivers/misc/mediatek/typec/fusb302b/Kconfig
```kconfig
config TCPC_FUSB302
    tristate "TCPC_FUSB302 driver"
    depends on I2C
    help
        Say Y or M here if your system has fusb302 ic controller.
```
